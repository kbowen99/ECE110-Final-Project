#include "CapacitiveSensor.h"
#include "pitches.h"

/*
 * ECE110 Final Project: Capacitive Sense Piano
 * Kurtis Bowen & Madison Smith
 * 
 * Uses Arduino's Capacitive Sensor Library by Paul Badger (https://playground.arduino.cc/Main/CapacitiveSensor?from=Main.CapSense)
 * The Pitches.h File Provided by Brett Hagman (https://www.arduino.cc/en/Tutorial/ToneMelody?from=Tutorial.Tone)
 * Midi File Conversion (and Player function) by GogoTronics (https://sparks.gogo.co.nz/midi_tone.html)
 * and public domain midi files (archive.org)
 * 
 * 
 */


//Music Used for Demo Mode
static const uint16_t MidnightSonata[] PROGMEM = { 
        0b0101010101000001, 0b0101010101010001, 0b0101011001010100, 0b0101010101001000, 
        0b0101010101010001, 0b0101011001010100, 0b0101010101001000, 0b0101010101010001, 
        0b0101011001010100, 0b0101010101001000, 0b0101010101010001, 0b0101011001010100, 
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        0b1111111101000001, 0b1111111101000001, 0b0000100001000001, 
  };

static const uint16_t furElise[] PROGMEM = { 
        0b1111000001100100, 0b1111000001100011, 0b1111000001100100, 0b1111000001100011, 
        0b1111000001100100, 0b1111000001011011, 0b1111000001100010, 0b1111000001100000, 
        0b1111000000111001, 0b1111000001000100, 0b1111000001001001, 0b1111000001010000, 
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        0b1111111100101001, 0b1010010100101001, 
  };

static const uint16_t imperialMarch[] PROGMEM = { 
        0b0000000001010010, 0b0000000001010111, 0b0111100000110111, 0b0000000011111111, 
        0b0000000001010010, 0b0000000001010111, 0b0000000011111111, 0b0111100000110111, 
        0b0000000011111111, 0b0000000001010010, 0b0000000001010111, 0b0000000011111111, 
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        0b0000000011111111, 
  };

#define NUM_OF_SAMPLES  10   // Higher number whens more delay but more consistent readings
#define CAP_THRESHOLD   200  // Capactive reading that triggers a note (adjust to fit your needs)

// Macro for creating Capcicitive Sensor Objects
#define CS(Y) CapacitiveSensor(2, Y)

//Our playable Octaves
int o1[] = {NOTE_C1, NOTE_D1, NOTE_E1, NOTE_F1, NOTE_G1, NOTE_A1, NOTE_B1};
int o2[] = {NOTE_C2, NOTE_D2, NOTE_E2, NOTE_F2, NOTE_G2, NOTE_A2, NOTE_B2};
int o3[] = {NOTE_C3, NOTE_D3, NOTE_E3, NOTE_F3, NOTE_G3, NOTE_A3, NOTE_B3};
int o4[] = {NOTE_C4, NOTE_D4, NOTE_E4, NOTE_F4, NOTE_G4, NOTE_A4, NOTE_B4};
int o5[] = {NOTE_C5, NOTE_D5, NOTE_E5, NOTE_F5, NOTE_G5, NOTE_A5, NOTE_B5};
int o6[] = {NOTE_C6, NOTE_D6, NOTE_E6, NOTE_F6, NOTE_G6, NOTE_A6, NOTE_B6};
int o7[] = {NOTE_C7, NOTE_D7, NOTE_E7, NOTE_F7, NOTE_G7, NOTE_A7, NOTE_B7};

// Defines the pins that the keys are connected to:
CapacitiveSensor keys[] = {CS(8), CS(7), CS(6), CS(5), CS(4), CS(3), CS(10)};
CapacitiveSensor octaveControl[] = {CS(11), CS(9)};

int keyTimeout = 30;
int currKey = 0;
int currOctave = 4;

int demoTimeout = 2*1000;
int demoTime = 0;

int intermissionTime = 4*1000;//Time between successive songs

//Used to determine the capsense values to use
boolean debugOut = true;
int debugPin = 12;

static uint16_t Melody0;
static int tempo;
int playLength = 1;

int octaveTime = 0;
int octaveTimeOut = 200;

//Randomly choose the next song. Could use some improvement
void chooseNewSong() {
  //randomSeed(analogRead(0));
  int tmp = random(4);
  Serial.println(tmp);
  switch(tmp){
    case 1:
      Melody0 = &furElise;
      tempo = 1;
      playLength = sizeof( furElise ) / sizeof(uint16_t);
      Serial.println("Fur Elise Chosen");
      break;
    case 2:
      Melody0 = &MidnightSonata;
      tempo = 3;
      playLength = sizeof( MidnightSonata ) / sizeof(uint16_t);
      Serial.println("Midnight Sonata Chosen");
      break;
    case 3:
      Melody0 = imperialMarch;
      tempo = 4;
      playLength = sizeof( imperialMarch ) / sizeof(uint16_t);
      Serial.println("Imperial March Chosen");
      break;
  }
}

void setup() { 
  Serial.begin(9600);
  //Demo LED
  pinMode(A0, OUTPUT);
  pinMode(debugPin, INPUT);
  digitalWrite(A0, LOW);
  // Turn off autocalibrate on all channels:
  for(int i=0; i<(sizeof(keys) / sizeof(keys[0])); ++i) {
    keys[i].set_CS_AutocaL_Millis(0xFFFFFFFF);
  }
  octaveControl[0].set_CS_AutocaL_Millis(0xFFFFFFFF);
  octaveControl[1].set_CS_AutocaL_Millis(0xFFFFFFFF);
  // Set the buzzer as an output:
  pinMode(BUZZER_PIN, OUTPUT); 
  chooseNewSong();
  
}

void loop() {    
  //Allows us to turn on/off serial port graphing on the fly. needed since graphing is quite slow
  debugOut = digitalRead(debugPin);
  // Loop through each key:
  for (int i = 0; i < (sizeof(keys) / sizeof(keys[0])); ++i) {
    // If the capacitance reading is greater than the threshold, play a note:
    if(keys[i].capacitiveSensor(NUM_OF_SAMPLES) > CAP_THRESHOLD) {
      tone(BUZZER_PIN, o3[i]); // Plays the note corresponding to the key pressed
      //Allows switching of octaves
      switch(currOctave) {
         case 1:
            tone(BUZZER_PIN, o1[i]);
            break;
         case 2:
            tone(BUZZER_PIN, o2[i]);
            break;
         case 3:
            tone(BUZZER_PIN, o3[i]);
            break;
         case 5:
            tone(BUZZER_PIN, o5[i]);
            break;
         case 6:
            tone(BUZZER_PIN, o6[i]);
            break;
         case 7:
            tone(BUZZER_PIN, o7[i]);
            break;
         default:
            tone(BUZZER_PIN, o4[i]);
      }
      currKey = keyTimeout;
    }

    if (debugOut){
      Serial.print(keys[i].capacitiveSensor(NUM_OF_SAMPLES));
      Serial.print(" ");
    }
  }

  if (octaveTime <= 0){
    if (octaveControl[0].capacitiveSensor(NUM_OF_SAMPLES) > CAP_THRESHOLD){
      currOctave++;
      Serial.println(currOctave);
      octaveTime = octaveTimeOut;
    } else if (octaveControl[1].capacitiveSensor(NUM_OF_SAMPLES) > CAP_THRESHOLD) {
      currOctave--;
      Serial.println(currOctave);
      octaveTime = octaveTimeOut;
    }

    if (currOctave > 7){
      currOctave = 1;
      Serial.println(currOctave);
    } else if (currOctave < 1) {
      currOctave = 7;
      Serial.println(currOctave);
    }
  } else {
    octaveTime--;
  }
  
  if (debugOut) {
    Serial.println();
  }
  
  if (currKey <= 0) {
    noTone(BUZZER_PIN);
    demoTime++;
  } else {
    currKey--;
    demoTime = 0;
  } 

  if (demoTime > demoTimeout){
    playMelody_Data(Melody0,playLength, tempo);
  } 
}



//Demo Music! (Gogotronics) with modification for interruption
void playMelody_Data(const uint16_t MelodyData[], const uint16_t MelodyLength, const uint8_t tempo)
{
  digitalWrite(A0, HIGH);
  // 8th Octave Frequencies C8 to B8, lower octaves are calculated from this
  static const uint16_t Freq8[] PROGMEM = { 4186 , 4435 , 4699  , 4978 , 5274 , 5588 , 5920 , 6272 , 6645 , 7040 , 7459 , 7902 };

  for(uint16_t  x = 0; x < MelodyLength; x++)
  {
    uint16_t data = pgm_read_word((uint16_t *)&MelodyData[x]);
    if((data & 0xF) == 0xF) 
    {
      noTone(BUZZER_PIN);
    }
    else
    {
      uint16_t Freq = pgm_read_word(&Freq8[data&0xF]) / ( 1 << (8-(data>>4 & 0xF)) );
      tone(BUZZER_PIN, Freq);    

    }    

    for (int i = 0; i < (sizeof(keys) / sizeof(keys[0])); ++i) {
      if(keys[i].capacitiveSensor(NUM_OF_SAMPLES) > CAP_THRESHOLD) {
        demoTime = 0;
        digitalWrite(A0, LOW);
        chooseNewSong();
      }
    }

    if (demoTime < demoTimeout) {
      break;
    }
    
    int16_t Duration = data>>8;
    while(Duration--) delay(tempo);
  }
  Serial.println("-- Intermission --");
  demoTime = demoTimeout - intermissionTime;
  chooseNewSong();
}
